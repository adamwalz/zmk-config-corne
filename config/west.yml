## config/west.yml
```yaml
manifest:
  defaults:
    revision: v0.2
  remotes:
    - name: adamwalz
      url-base: https://github.com/adamwalz
    - name: zmkfirmware
      url-base: https://github.com/zmkfirmware
    # Additional modules containing boards/shields/custom code can be listed here as well
    # See https://docs.zephyrproject.org/3.2.0/develop/west/manifest.html#projects
  projects:
    - name: zmk
      remote: zmkfirmware
      import: app/west.yml
    - name: zmk-helpers
      remote: adamwalz
      revision: main
  self:
    path: config
```

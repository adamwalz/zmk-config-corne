#include <behaviors.dtsi>

#include <dt-bindings/zmk/keys.h>
#include <dt-bindings/zmk/ext_power.h>
#include <dt-bindings/zmk/bt.h>
#include <dt-bindings/zmk/backlight.h>
#include <dt-bindings/zmk/rgb.h>
#include <dt-bindings/zmk/outputs.h>

#include "zmk-helpers/helper.h"
#include "zmk-helpers/key-labels/adv360_custom.h"

#include "./mouse.dtsi"

#define LEFT_HAND_KEYS   LN6 LN5 LN4 LN3 LN2 LN1 LN0 \
                         LT6 LT5 LT4 LT3 LT2 LT1 LT0 \
                         LM6 LM5 LM4 LM3 LM2 LM1 LM0 \
                         LB5 LB4 LB3 LB2 LB1 LB0 \
                         LF4 LF3 LF2 LF1 LF0

#define RIGHT_HAND_KEYS  RN0 RN1 RN2 RN3 RN4 RN5 RN6 \
                         RT0 RT1 RT2 RT3 RT4 RT5 RT6 \
                         RM0 RM1 RM2 RM3 RM4 RM5 RM6 \
                             RB0 RB1 RB2 RB3 RB4 RB5 \
                                 RF0 RF1 RM2 RF3 RF4

#define THUMB_KEYS           LH5 LH4     RH4 RH5 \
                                 LH3     RH3 \
                         LH2 LH1 LH0     RH0 RH1 RH2

#include "general.h"
#include "homerow_mods.h"
#include "custom_behaviors.h"

#define BASE        0
#define LOWER       1
#define CURSOR      2
#define NUMBER      3
#define FUNCTION    4
#define SYMBOL      5
#define MOUSE       6
#define SYSTEM      7
#define MAGIC       8
#define PRACTICE42  9 // Typing practice for switching from base layer for numbers and symbols
#define PRACTICE36 10 // Typing practice for switching from base layer for numbers and symbols

#define TO_MAGIC  &mo MAGIC
#define ONEPASSWD &kp LG(LS(SPACE))
#define SPOTLIGHT &kp LG(SPACE)
#define EMOJI     &kp LG(LC(SPACE))

ADV360_LAYER(Base,
// ╭───────────────┬───────────┬─────────────┬─────────────┬─────────────┬────────────┬────────────╮   ╭─────────────┬─────────────┬─────────────┬─────────────┬─────────────┬─────────────┬─────────────╮
     &kp GRAVE       &kp N1      &kp N2        &kp N3        &kp N4        &kp N5       XXX              XXX           &kp N6        &kp N7        &kp N8        &kp N9        &kp N0        &kp MINUS
// ├───────────────┼───────────┼─────────────┼─────────────┼─────────────┼────────────┼────────────┤   ├─────────────┼─────────────┼─────────────┼─────────────┼─────────────┼─────────────┼─────────────┤
     &kp TAB         &kp Q       &kp W         &kp E         &kp R         &kp T        XXX              XXX           &kp Y         &kp U         &kp I         &kp O         &kp P         &kp BSLH
// ├───────────────┼───────────┼─────────────┼─────────────┼─────────────┼────────────┼────────────┤   ├─────────────┼─────────────┼─────────────┼─────────────┼─────────────┼─────────────┼─────────────┤
     &mt LCTRL ESC   A_LCTRL     S_LALT        D_LGUI        F_LSHFT       &kp G        XXX          ,   XXX           &kp H         J_RSHFT       K_RGUI        L_RALT        SEMI_RCTRL    &kp SQT
// ├───────────────┼───────────┼─────────────┼─────────────┼─────────────┼────────────┼────────────┤   ╰─────────────┼─────────────┼─────────────┼─────────────┼─────────────┼─────────────┼─────────────┤
     &kp GRAVE       &kp Z       &kp X         &kp C         &kp V         &kp B                     ,                 &kp N         &kp M         &kp COMMA     &kp DOT       &kp FSLH      &kp EQUAL
// ├───────────────┼───────────┼─────────────┼─────────────┼─────────────┼────────────╯                              ╰─────────────┼─────────────┼─────────────┼─────────────┼─────────────┼─────────────┤
     TO_MAGIC        XXX         XXX           &kp LEFT      &kp RIGHT                               ,                               &kp LPAR      &kp LBKT      &kp RBKT      &kp RPAR      TO_MAGIC
/* ╰───────────────┴───────────┴─────────────┴─────────────┴─────────────╯                        */ , /*                          ╰─────────────┴──────────────┴────────────┴─────────────┴─────────────╯ */
//                                                             ╭───────────────────┬────────────╮         ╭─────────────────────┬────────────────────╮
                                                                 &smart_shft         ONEPASSWD              SPOTLIGHT             &thumb MOUSE DEL
/*                                       ╭─────────────────────┼───────────────────┼────────────┤ */ , /* ├─────────────────────┼────────────────────┼─────────────────────╮ */
                                                                                     EMOJI                  &mo LOWER
/*                                       |                     |                   ├────────────┤ */ , /* ├─────────────────────|                    |                     | */
                                           &thumb CURSOR BSPC    &thumb NUMBER ESC   &mo LOWER              &thumb FUNCTION TAB   &thumb SYSTEM RET    &space SYMBOL SPACE
//                                       ╰─────────────────────┴───────────────────┴────────────╯         ╰─────────────────────┴────────────────────┴─────────────────────╯
)


ADV360_LAYER(Lower,
// ╭─────────────┬─────────────┬─────────────┬─────────────┬─────────────┬────────────┬────────────╮   ╭─────────────┬─────────────────┬─────────────┬──────────────┬──────────────┬──────────────────────┬─────────────────╮
     &kp EQUAL     XXX           XXX           XXX           XXX           &kp HOME     XXX              XXX           &kp SCROLLLOCK    &kp KP_NUM    &kp KP_EQUAL   &kp KP_SLASH   &kp KP_MULTIPLY        &kp PRINTSCREEN
// ├─────────────┼─────────────┼─────────────┼─────────────┼─────────────┼────────────┼────────────┤   ├─────────────┼─────────────────┼─────────────┼──────────────┼──────────────┼──────────────────────┼─────────────────┤
     ___           XXX           XXX           &kp UP        XXX           &kp END      XXX              XXX           &kp LPAR          &kp KP_N7     &kp KP_N8      &kp KP_N9      &kp_minus_kp_slash     &kp RPAR
// ├─────────────┼─────────────┼─────────────┼─────────────┼─────────────┼────────────┼────────────┤   ├─────────────┼─────────────────┼─────────────┼──────────────┼──────────────┼──────────────────────┼─────────────────┤
     ___           XXX           &kp LEFT      &kp DOWN      &kp RIGHT     &kp PG_UP    XXX          ,   XXX           &kp PRCNT         &kp KP_N4     &kp KP_N5      &kp KP_N4      &kp_plus_kp_multiply   &kp KP_EQUAL
// ├─────────────┼─────────────┼─────────────┼─────────────┼─────────────┼────────────┼────────────╯   ╰─────────────┼─────────────────┼─────────────┼──────────────┼──────────────┼──────────────────────┼─────────────────┤
     ___           &kp K_APP     &kp CAPS      &kp F11       &kp F12       &kp PG_DN                 ,                 &kp KP_N0         &kp KP_N1     &kp KP_N2      &kp KP_N3     &kp_dot_comma          &kp KP_ENTER
// ├─────────────┼─────────────┼─────────────┼─────────────┼─────────────┼────────────╯                              ╰─────────────────┼─────────────┼──────────────┼──────────────┼──────────────────────┼─────────────────┤
     ___           XXX           &kp INSERT    XXX           XXX                                     ,                                   ___           ___             ___           ___                    ___
/* ╰─────────────┴─────────────┴─────────────┴─────────────┴─────────────╯                        */ , /*                             ╰──────────────┴──────────────┴──────────────┴──────────────────────┴─────────────────╯ */
//                                                              ╭──────────────────┬────────────╮         ╭───────────────┬───────────────╮
                                                                  ___                ___                    ___             &tog MOUSE
/*                                             ╭────────────────┼──────────────────┼────────────┤ */ , /* ├───────────────┼───────────────┼─────────────────────╮ */
                                                                                     &tog LOWER             &tog LOWER
/*                                             |                |                  ├────────────┤ */ , /* ├───────────────|               |                     | */
                                                  &tog CURSOR     &tog NUMBER        XXX                    &tog FUNCTION   &tog SYSTEM     &tog SYMBOL
//                                             ╰────────────────┴──────────────────┴────────────╯         ╰───────────────┴───────────────┴─────────────────────╯
)

ADV360_LAYER(Cursor,
// ╭───────────────┬───────────────┬───────────────┬───────────────┬───────────────┬───────────────┬───────────────╮   ╭────────────────┬───────────────┬───────────────┬───────────────┬───────────────┬───────────────┬───────────────╮
     &kp ESC         &kp RET         &kp SPACE       &kp TAB         &kp DEL         &kp INSERT      XXX                 XXX              &kp INSERT      &kp DEL         &kp TAB         &kp SPACE       &kp RET         &kp ESC
// ├───────────────┼───────────────┼───────────────┼───────────────┼───────────────┼───────────────┼───────────────┤   ├────────────────┼───────────────┼───────────────┼───────────────┼───────────────┼───────────────┼───────────────┤
     &kp LG(H)       &extend_line    &kp LG(LS(Z))   &kp LG(Z)       &extend_word    &copy_cut       XXX                 XXX              &copy_cut       &extend_word    &kp LG(Z)       &kp LG(LS(Z))   &extend_line    &kp LG(H)
// ├───────────────┼───────────────┼───────────────┼───────────────┼───────────────┼───────────────┼───────────────┤   ├────────────────┼───────────────┼───────────────┼───────────────┼───────────────┼───────────────┼───────────────┤
     &kp LG(G)       &kp LCTRL       &kp LALT        &kp LGUI        &kp LSHFT       &kp LG(V)       XXX             ,   XXX              &kp LG(V)       &kp LEFT        &kp UP          &kp DOWN        &kp RIGHT       &kp LG(G)
// ├───────────────┼───────────────┼───────────────┼───────────────┼───────────────┼───────────────┼───────────────╯   ╰────────────────┼───────────────┼───────────────┼───────────────┼───────────────┼───────────────┼───────────────┤
     &kp LG(LS(G))   &select_line    &kp LG(A)       &kp LG(F)       &select_word    &select_none                    ,                    &select_none    &select_word    &kp LG(F)       &kp LG(A)       &select_line    &kp LG(LS(G))
// ├───────────────┼───────────────┼───────────────┼───────────────┼───────────────┼───────────────╯                                    ╰───────────────┼───────────────┼───────────────┼───────────────┼───────────────┼───────────────┤
     &kp LG(J)       &kp LG(K)       &kp LG(L)       &sk LSHFT       &kp BSPC                                        ,                                    &kp BSPC        &sk LSHFT       &kp LG(L)       &kp LG(K)       &kp LG(DOT)
/* ╰───────────────┴───────────────┴───────────────┴───────────────┴───────────────╯                              */ , /*                               ╰───────────────┴───────────────┴───────────────┴───────────────┴───────────────╯ */
//                                                                             ╭────────────────┬───────────────╮         ╭───────────────┬───────────────╮
                                                                                 &select_word     &select_line              &extend_line    &extend_word
/*                                                             ╭───────────────┼────────────────┼───────────────┤ */ , /* ├───────────────┼───────────────┼────────────────╮ */
                                                                                                  &kp LG(A)                 &select_none
/*                                                             |               |                ├───────────────┤ */ , /* ├───────────────|               |                | */
                                                                 &kp HOME        &kp TAB          &tog CURSOR               &kp PG_UP       &kp PG_DN       &kp END
//                                                             ╰───────────────┴────────────────┴───────────────╯         ╰───────────────┴───────────────┴────────────────╯
)

ADV360_LAYER(Number,
// ╭───────────────┬───────────────┬───────────────┬───────────────┬───────────────┬───────────────┬───────────────╮   ╭────────────────┬───────────────┬───────────────┬───────────────┬───────────────┬───────────────┬─────────────────╮
     &kp ESC         &kp RET         &kp SPACE       &kp TAB         &kp DEL         &kp INSERT      XXX                 XXX              &kp TILDE       &kp CARET       &kp HASH        &kp DLLR        &kp EXCL        &kp PIPE
// ├───────────────┼───────────────┼───────────────┼───────────────┼───────────────┼───────────────┼───────────────┤   ├────────────────┼───────────────┼───────────────┼───────────────┼───────────────┼───────────────┼─────────────────┤
     &kp A           &extend_line    &kp LG(LS(Z))   &kp LG(Z)       &extend_word    &kp D           XXX                 XXX              &kp LS(G)       &kp N7          &kp N8          &kp N9          &kp COLON       &kp PRCNT
// ├───────────────┼───────────────┼───────────────┼───────────────┼───────────────┼───────────────┼───────────────┤   ├────────────────┼───────────────┼───────────────┼───────────────┼───────────────┼───────────────┼─────────────────┤
     &kp B           &kp LCTRL       &kp LALT        &kp LGUI        &kp LSHFT       &kp E           XXX             ,   XXX              &kp K           &kp N4          &kp N5          &kp N6          &kp MINUS       &kp PLUS
// ├───────────────┼───────────────┼───────────────┼───────────────┼───────────────┼───────────────┼───────────────╯   ╰────────────────┼───────────────┼───────────────┼───────────────┼───────────────┼───────────────┼─────────────────┤
     &kp C           &select_line    &kp LG(A)       &kp X           &select_word    &select_none                    ,                    &kp J           &kp N1          &kp N2          &kp N3          &kp SLASH       &kp STAR
// ├───────────────┼───────────────┼───────────────┼───────────────┼───────────────┼───────────────╯                                    ╰───────────────┼───────────────┼───────────────┼───────────────┼───────────────┼─────────────────┤
     XXX             XXX             &kp UNDER       &sk LSHFT       &kp BSPC                                        ,                                    &kp LT          &kp LPAR        &kp RPAR        &kp GT          &kp AT
/* ╰───────────────┴───────────────┴───────────────┴───────────────┴───────────────╯                              */ , /*                               ╰───────────────┴───────────────┴───────────────┴───────────────┴─────────────────╯ */
//                                                                             ╭────────────────┬───────────────╮         ╭───────────────┬───────────────╮
                                                                                 XXX              XXX                       &kp RBKT        &kp EQUAL
/*                                                             ╭───────────────┼────────────────┼───────────────┤ */ , /* ├───────────────┼───────────────┼────────────────╮ */
                                                                                                  XXX                       &kp LBKT
/*                                                             |               |                ├───────────────┤ */ , /* ├───────────────|               |                | */
                                                                 &kp EQUAL       XXX              &tog NUMBER               &kp COMMA       &kp DOT         &kp N0
//                                                             ╰───────────────┴────────────────┴───────────────╯         ╰───────────────┴───────────────┴────────────────╯
)

ADV360_LAYER(Function,
// ╭───────────────┬───────────────┬───────────────┬───────────────┬───────────────┬───────────────┬───────────────╮   ╭────────────────┬───────────────┬───────────────┬───────────────┬────────────────┬──────────────┬───────────────╮
     &kp ESC         &kp RET         &kp SPACE       &kp TAB         &kp DEL         &kp INS         XXX                 XXX              XXX             &kp C_PLAY      &kp C_PREV      &kp C_NEXT      &kp C_STOP      &kp C_EJECT
// ├───────────────┼───────────────┼───────────────┼───────────────┼───────────────┼───────────────┼───────────────┤   ├────────────────┼───────────────┼───────────────┼───────────────┼────────────────┼──────────────┼───────────────┤
     XXX             &extend_line    &kp LG(LS(Z))   &kp LG(Z)       &extend_word    XXX             XXX                 XXX              XXX             &kp F7          &kp F8          &kp F9          &kp F10         &kp F13
// ├───────────────┼───────────────┼───────────────┼───────────────┼───────────────┼───────────────┼───────────────┤   ├────────────────┼───────────────┼───────────────┼───────────────┼────────────────┼──────────────┼───────────────┤
     XXX             &kp LCTRL       &kp LALT        &kp LGUI        &kp RSHFT       XXX             XXX             ,   XXX              XXX             &kp F4          &kp F5          &kp F6          &kp F11         &kp F14
// ├───────────────┼───────────────┼───────────────┼───────────────┼───────────────┼───────────────┼───────────────╯   ╰────────────────┼───────────────┼───────────────┼───────────────┼────────────────┼──────────────┼───────────────┤
     XXX             &select_line    &kp LG(A)       XXX             &select_word    &select_none                    ,                    XXX             &kp F1          &kp F2          &kp F3          &kp F12         &kp F15
// ├───────────────┼───────────────┼───────────────┼───────────────┼───────────────┼───────────────╯                                    ╰───────────────┼───────────────┼───────────────┼────────────────┼──────────────┼───────────────┤
     XXX             XXX             XXX             &sk LSHFT       &kp BSPC                                        ,                                    &kp C_BRI_MAX   &kp C_BRI_UP    &kp C_BRI_DN    &kp C_BRI_MIN   &kp C_BRI_AUTO
/* ╰───────────────┴───────────────┴───────────────┴───────────────┴───────────────╯                              */ , /*                               ╰───────────────┴───────────────┴────────────────┴──────────────┴───────────────╯ */
//                                                                             ╭────────────────┬───────────────╮         ╭───────────────┬───────────────╮
                                                                                 &kp C_PREV       &kp C_NEXT                XXX             XXX
/*                                                             ╭───────────────┼────────────────┼───────────────┤ */ , /* ├───────────────┼───────────────┼────────────────╮ */
                                                                                                  &kp C_PP                  XXX
/*                                                             |               |                ├───────────────┤ */ , /* ├───────────────|               |                | */
                                                                 &kp C_MUTE      &kp C_VOL_DN     &kp C_VOL_UP              &tog FUNCTION   XXX             XXX
//                                                             ╰───────────────┴────────────────┴───────────────╯         ╰───────────────┴───────────────┴────────────────╯
)

ADV360_LAYER(Symbol,
// ╭─────────────┬─────────────┬─────────────┬─────────────┬─────────────┬────────────┬────────────╮   ╭─────────────┬─────────────┬─────────────┬─────────────┬─────────────┬─────────────┬─────────────╮
     XXX           &kp GRAVE     &kp SQT       &kp DQT       &kp SEMI      &kp COMMA    XXX              XXX           XXX           XXX           XXX           XXX           XXX           XXX
// ├─────────────┼─────────────┼─────────────┼─────────────┼─────────────┼────────────┼────────────┤   ├─────────────┼─────────────┼─────────────┼─────────────┼─────────────┼─────────────┼─────────────┤
     &kp QMARK     &kp LBRC      &kp LBKT      &kp RBKT      &kp RBRC      &kp SQT      XXX              XXX           &kp EXCL      &kp RSHFT     &kp LGUI      &kp RALT      &kp RCTRL     XXX
// ├─────────────┼─────────────┼─────────────┼─────────────┼─────────────┼────────────┼────────────┤   ├─────────────┼─────────────┼─────────────┼─────────────┼─────────────┼─────────────┼─────────────┤
     &kp LT        CARET_LCTRL   EQUAL_LALT    UNDER_LGUI    DLLR_LSHFT    &kp STAR     XXX          ,   XXX           &kp HASH      &kp BSPC      &kp TAB       &kp SPC       &kp ENTER     &kp GT
// ├─────────────┼─────────────┼─────────────┼─────────────┼─────────────┼────────────┼────────────┤   ╰─────────────┼─────────────┼─────────────┼─────────────┼─────────────┼─────────────┼─────────────┤
     XXX           &kp LPAR      &kp AMPS      &kp MINUS     &kp PLUS      &kp RPAR                  ,                 &kp AT        &kp DEL       &kp LS(TAB)   XXX           XXX           XXX
// ├─────────────┼─────────────┼─────────────┼─────────────┼─────────────┼────────────╯                              ╰─────────────┼─────────────┼─────────────┼─────────────┼─────────────┼─────────────┤
     &kp TILDE     &kp LT        &kp PIPE      &kp PLUS      &kp GT                                  ,                               &kp LPAR      &kp LBKT      &kp RBKT      &kp RPAR      XXX
/* ╰─────────────┴─────────────┴─────────────┴─────────────┴─────────────╯                        */ , /*                          ╰─────────────┴─────────────┴─────────────┴─────────────┴─────────────╯ */
//                                                                ╭──────────────────┬──────────╮         ╭─────────────┬───────────────╮
                                                                     &kp BSLH          &kp DOT              XXX           XXX
/*                                               ╭────────────────┼──────────────────┼──────────┤ */ , /* ├─────────────┼───────────────┼─────────────────────╮ */
                                                                                       &kp STAR             XXX
/*                                               |                |                  ├──────────┤ */ , /* ├─────────────|               |                     | */
                                                   &kp PRCNT        &kp COLON          &kp BSLH             &tog SYMBOL   XXX             XXX
//                                               ╰────────────────┴──────────────────┴──────────╯         ╰─────────────┴───────────────┴─────────────────────╯
)


ADV360_LAYER(Mouse,
// ╭─────────────┬─────────────┬─────────────┬─────────────┬─────────────┬────────────┬────────────╮   ╭─────────────┬─────────────┬─────────────┬─────────────┬─────────────┬─────────────┬─────────────╮
     XXX           XXX           XXX           XXX           XXX           XXX          XXX              XXX           XXX           XXX           XXX           XXX           XXX           XXX
// ├─────────────┼─────────────┼─────────────┼─────────────┼─────────────┼────────────┼────────────┤   ├─────────────┼─────────────┼─────────────┼─────────────┼─────────────┼─────────────┼─────────────┤
     XXX           XXX           &kp RALT      XXX           XXX           XXX          XXX              XXX           &mkp MCLK     &kp RSHFT     &kp LGUI      &kp RALT      &kp RCTRL     XXX
// ├─────────────┼─────────────┼─────────────┼─────────────┼─────────────┼────────────┼────────────┤   ├─────────────┼─────────────┼─────────────┼─────────────┼─────────────┼─────────────┼─────────────┤
     XXX           &kp LCTRL     &kp LALT      &kp LGUI      &kp LSHFT     XXX          XXX          ,   XXX           &mkp LCLK     XXX           XXX           XXX           XXX           XXX
// ├─────────────┼─────────────┼─────────────┼─────────────┼─────────────┼────────────┼────────────┤   ╰─────────────┼─────────────┼─────────────┼─────────────┼─────────────┼─────────────┼─────────────┤
     XXX           XXX           XXX           XXX           XXX           XXX                       ,                 &mkp RCLK     XXX           XXX           XXX           XXX           XXX
// ├─────────────┼─────────────┼─────────────┼─────────────┼─────────────┼────────────╯                              ╰─────────────┼─────────────┼─────────────┼─────────────┼─────────────┼─────────────┤
     XXX           XXX           XXX           XXX           XXX                                     ,                               XXX           XXX           XXX           XXX           XXX
/* ╰─────────────┴─────────────┴─────────────┴─────────────┴─────────────╯                        */ , /*                          ╰─────────────┴─────────────┴─────────────┴─────────────┴─────────────╯ */
//                                                                ╭──────────────────┬──────────╮         ╭───────────┬───────────────╮
                                                                    &mkp MCLK          XXX                  XXX         XXX
/*                                               ╭────────────────┼──────────────────┼──────────┤ */ , /* ├───────────┼───────────────┼─────────────────────╮ */
                                                                                       XXX                  XXX
/*                                               |                |                  ├──────────┤ */ , /* ├───────────|               |                     | */
                                                   &mkp LCLK        &mkp RCLK          XXX                  &tog MOUSE  XXX             XXX
//                                               ╰────────────────┴──────────────────┴──────────╯         ╰───────────┴───────────────┴─────────────────────╯
)

ADV360_LAYER(System,
// ╭─────────────────┬─────────────────┬─────────────────┬─────────────────┬─────────────────┬───────────────┬───────────────╮   ╭────────────────┬─────────────────┬─────────────────┬─────────────────┬──────────────────┬─────────────────┬─────────────────╮
     XXX               XXX               XXX               XXX               XXX               XXX             XXX                 XXX              XXX               XXX               XXX               XXX                XXX               XXX
// ├─────────────────┼─────────────────┼─────────────────┼─────────────────┼─────────────────┼───────────────┼───────────────┤   ├────────────────┼─────────────────┼─────────────────┼─────────────────┼──────────────────┼─────────────────┼─────────────────┤
     XXX               XXX               &rgb_ug RGB_HUD   &rgb_ug RGB_HUI   XXX               &kp SLCK        XXX                 XXX              &rgb_ug RGB_SAI   &kp LSHFT         &kp LGUI          &kp LALT           &kp LCTRL         &rgb_ug RGB_SAD
// ├─────────────────┼─────────────────┼─────────────────┼─────────────────┼─────────────────┼───────────────┼───────────────┤   ├────────────────┼─────────────────┼─────────────────┼─────────────────┼──────────────────┼─────────────────┼─────────────────┤
     &rgb_ug RGB_TOG   XXX               &rgb_ug RGB_BRD   &rgb_ug RGB_BRI                     &kp CAPS        XXX             ,   XXX              &rgb_ug RGB_HUI   XXX               XXX               XXX                XXX               &rgb_ug RGB_HUD
// ├─────────────────┼─────────────────┼─────────────────┼─────────────────┼─────────────────┼───────────────┼───────────────╯   ╰────────────────┼─────────────────┼─────────────────┼─────────────────┼──────────────────┼─────────────────┼─────────────────┤
     &bl BL_TOG        XXX               &rgb_ug RGB_SAD   &rgb_ug RGB_SAI   XXX               &kp KP_NUM                      ,                    XXX               &rgb_ug RGB_TOG   &kp PSCRN         &kp SLCK           XXX               XXX
// ├─────────────────┼─────────────────┼─────────────────┼─────────────────┼─────────────────┼───────────────╯                                    ╰─────────────────┼─────────────────┼─────────────────┼──────────────────┼─────────────────┼─────────────────┤
     XXX               XXX               &bl BL_INC        &bl BL_DEC        XXX                                               ,                                      XXX               &rgb_ug RGB_BRI   &rgb_ug RGB_BRD    XXX               XXX
/* ╰─────────────────┴─────────────────┴─────────────────┴─────────────────┴─────────────────╯                              */ , /*                                 ╰─────────────────┴─────────────────┴──────────────────┴─────────────────┴─────────────────╯ */
//                                                                                     ╭────────────────┬─────────────────╮         ╭───────────────┬───────────────╮
                                                                                         XXX              XXX                         XXX             XXX
/*                                                                     ╭───────────────┼────────────────┼─────────────────┤ */ , /* ├───────────────┼───────────────┼────────────────╮ */
                                                                                                          XXX                         XXX
/*                                                                     |               |                ├─────────────────┤ */ , /* ├───────────────|               |                | */
                                                                         &kp PSCRN       XXX              XXX                         &tog SYSTEM     XXX             XXX
//                                                                     ╰───────────────┴────────────────┴─────────────────╯         ╰───────────────┴───────────────┴────────────────╯
)

ADV360_LAYER(Magic,
// ╭─────────────┬─────────────────┬─────────────────┬─────────────────┬─────────────────┬──────────────────┬──────────────╮   ╭─────────────────────────┬─────────────┬─────────────┬─────────────┬─────────────┬─────────────┬─────────────────╮
     XXX           &bt_sel 1         &bt_sel 2         &bt_sel 3         &bt_sel 4         &bt_sel 5          &out OUT_USB       XXX                       XXX           XXX           XXX           XXX           XXX           XXX
// ├─────────────┼─────────────────┼─────────────────┼─────────────────┼─────────────────┼──────────────────┼──────────────┤   ├─────────────────────────┼─────────────┼─────────────┼─────────────┼─────────────┼─────────────┼─────────────────┤
     &to 0         &to 1             &to 2             &to 3             &to 4             &to 5              &bootloader        &bootloader               &to 6         &to 7         &to 9         &to 10        XXX           XXX
// ├─────────────┼─────────────────┼─────────────────┼─────────────────┼─────────────────┼──────────────────┼──────────────┤   ├─────────────────────────┼─────────────┼─────────────┼─────────────┼─────────────┼─────────────┼─────────────────┤
     XXX           &rgb_ug RGB_SPI   &rgb_ug RGB_SAI   &rgb_ug RGB_HUI   &rgb_ug RGB_BRI   &rgb_ug RGB_TOG    &sys_reset     ,   &sys_reset                XXX           XXX           XXX           XXX           XXX           &tog PRACTICE42
// ├─────────────┼─────────────────┼─────────────────┼─────────────────┼─────────────────┼──────────────────┼──────────────┤   ╰─────────────────────────┼─────────────┼─────────────┼─────────────┼─────────────┼─────────────┼─────────────────┤
     XXX           &rgb_ug RGB_SPD   &rgb_ug RGB_SAD   &rgb_ug RGB_HUD   &rgb_ug RGB_BRD   &rgb_ug RGB_EFF                  ,                              XXX           XXX           XXX           XXX           XXX           &tog PRACTICE36
// ├─────────────┼─────────────────┼─────────────────┼─────────────────┼─────────────────┼──────────────────╯                                            ╰─────────────┼─────────────┼─────────────┼─────────────┼─────────────┼─────────────────┤
     XXX           XXX               XXX               XXX               XXX                                                 ,                                           &bl BL_INC    &bl BL_DEC    XXX           XXX           XXX
/* ╰─────────────┴─────────────────┴─────────────────┴─────────────────┴─────────────────╯                                */ , /*                                      ╰─────────────┴─────────────┴─────────────┴─────────────┴─────────────────╯ */
//                                                                                        ╭──────────────────┬──────────╮         ╭─────────────┬───────────────╮
                                                                                            XXX                XXX                  &bt BT_CLR    XXX
/*                                                                       ╭────────────────┼──────────────────┼──────────┤ */ , /* ├─────────────┼───────────────┼─────────────────────╮ */
                                                                                                               XXX                  XXX
/*                                                                       |                |                  ├──────────┤ */ , /* ├─────────────|               |                     | */
                                                                            XXX             XXX                XXX                  XXX           &bl BL_TOG       XXX
//                                                                       ╰────────────────┴──────────────────┴──────────╯         ╰─────────────┴───────────────┴─────────────────────╯
)

ADV360_LAYER(Practice42,
// ╭───────────────┬───────────────┬───────────────┬───────────────┬───────────────┬───────────────┬───────────────╮   ╭────────────────┬───────────────┬───────────────┬───────────────┬───────────────┬───────────────┬───────────────╮
     XXX             XXX             XXX             XXX             XXX             XXX             XXX                 XXX              XXX             XXX             XXX             XXX             XXX             XXX
// ├───────────────┼───────────────┼───────────────┼───────────────┼───────────────┼───────────────┼───────────────┤   ├────────────────┼───────────────┼───────────────┼───────────────┼───────────────┼───────────────┼───────────────┤
     &kp TAB         &kp Q           &kp W           &kp E           &kp R           &kp T           XXX                 XXX              &kp Y           &kp U           &kp I           &kp O           &kp P           &kp BSLH
// ├───────────────┼───────────────┼───────────────┼───────────────┼───────────────┼───────────────┼───────────────┤   ├────────────────┼───────────────┼───────────────┼───────────────┼───────────────┼───────────────┼───────────────┤
     &mt LCTRL ESC   A_LCTRL         S_LALT          D_LGUI          F_LSHFT         &kp G           XXX             ,   XXX              &kp H           J_RSHFT         K_RGUI          L_RALT          SEMI_RCTRL      &kp SQT
// ├───────────────┼───────────────┼───────────────┼───────────────┼───────────────┼───────────────┼───────────────╯   ╰────────────────┼───────────────┼───────────────┼───────────────┼───────────────┼───────────────┼───────────────┤
     &kp GRAVE       &kp Z           &kp X           &kp C           &kp V           &kp B                           ,                    &kp N           &kp M           &kp COMMA       &kp DOT         &kp FSLH        &kp EQUAL
// ├───────────────┼───────────────┼───────────────┼───────────────┼───────────────┼───────────────╯                                    ╰───────────────┼───────────────┼───────────────┼───────────────┼───────────────┼───────────────┤
     XXX             XXX             XXX             XXX             XXX                                             ,                                    XXX             XXX             XXX             XXX             XXX
/* ╰───────────────┴───────────────┴───────────────┴───────────────┴───────────────╯                              */ , /*                               ╰───────────────┴───────────────┴───────────────┴───────────────┴───────────────╯ */
//                                                                          ╭───────────────────┬───────────────╮         ╭─────────────────┬───────────────────╮
                                                                              XXX                 XXX                       XXX               XXX
/*                                                    ╭─────────────────────┼───────────────────┼───────────────┤ */ , /* ├─────────────────┼───────────────────┼──────────────────────╮ */
                                                                                                  XXX                       XXX
/*                                                    |                     |                   ├───────────────┤ */ , /* ├─────────────────|                   |                      | */
                                                        &thumb CURSOR BSPC    &thumb NUMBER ESC   &mo LOWER                 &tog PRACTICE42   &thumb SYSTEM RET   &space SYMBOL SPACE
//                                                    ╰─────────────────────┴───────────────────┴───────────────╯         ╰─────────────────┴───────────────────┴──────────────────────╯
)

ADV360_LAYER(Practice36,
// ╭───────────────┬───────────────┬───────────────┬───────────────┬───────────────┬───────────────┬───────────────╮   ╭────────────────┬───────────────┬───────────────┬───────────────┬───────────────┬───────────────┬───────────────╮
     XXX             XXX             XXX             XXX             XXX             XXX             XXX                 XXX              XXX             XXX             XXX             XXX             XXX             XXX
// ├───────────────┼───────────────┼───────────────┼───────────────┼───────────────┼───────────────┼───────────────┤   ├────────────────┼───────────────┼───────────────┼───────────────┼───────────────┼───────────────┼───────────────┤
     XXX             &kp Q           &kp W           &kp E           &kp R           &kp T           XXX                 XXX              &kp Y           &kp U           &kp I           &kp O           &kp P           XXX
// ├───────────────┼───────────────┼───────────────┼───────────────┼───────────────┼───────────────┼───────────────┤   ├────────────────┼───────────────┼───────────────┼───────────────┼───────────────┼───────────────┼───────────────┤
     XXX             A_LCTRL         S_LALT          D_LGUI          F_LSHFT         &kp G           XXX             ,   XXX              &kp H           J_RSHFT         K_RGUI          L_RALT          SEMI_RCTRL      XXX
// ├───────────────┼───────────────┼───────────────┼───────────────┼───────────────┼───────────────┼───────────────╯   ╰────────────────┼───────────────┼───────────────┼───────────────┼───────────────┼───────────────┼───────────────┤
     XXX             &kp Z           &kp X           &kp C           &kp V           &kp B                           ,                    &kp N           &kp M           &kp COMMA       &kp DOT         &kp FSLH        XXX
// ├───────────────┼───────────────┼───────────────┼───────────────┼───────────────┼───────────────╯                                    ╰───────────────┼───────────────┼───────────────┼───────────────┼───────────────┼───────────────┤
     XXX             XXX             XXX             XXX             XXX                                             ,                                    XXX             XXX             XXX             XXX             XXX
/* ╰───────────────┴───────────────┴───────────────┴───────────────┴───────────────╯                              */ , /*                               ╰───────────────┴───────────────┴───────────────┴───────────────┴───────────────╯ */
//                                                                          ╭───────────────────┬───────────────╮         ╭─────────────────┬───────────────────╮
                                                                              XXX                 XXX                       XXX               XXX
/*                                                    ╭─────────────────────┼───────────────────┼───────────────┤ */ , /* ├─────────────────┼───────────────────┼──────────────────────╮ */
                                                                                                  XXX                       XXX
/*                                                    |                     |                   ├───────────────┤ */ , /* ├─────────────────|                   |                      | */
                                                        &thumb CURSOR BSPC    &thumb NUMBER ESC   &mo LOWER                 &tog PRACTICE36   &thumb SYSTEM RET   &space SYMBOL SPACE
//                                                    ╰─────────────────────┴───────────────────┴───────────────╯         ╰─────────────────┴───────────────────┴──────────────────────╯
)

//ADV360_LAYER(Template,
//// ╭───────────────┬───────────────┬───────────────┬───────────────┬───────────────┬───────────────┬───────────────╮   ╭────────────────┬───────────────┬───────────────┬───────────────┬───────────────┬───────────────┬───────────────╮
//     XXX             XXX             XXX             XXX             XXX             XXX             XXX                 XXX              XXX             XXX             XXX             XXX             XXX             XXX
//// ├───────────────┼───────────────┼───────────────┼───────────────┼───────────────┼───────────────┼───────────────┤   ├────────────────┼───────────────┼───────────────┼───────────────┼───────────────┼───────────────┼───────────────┤
//     XXX             XXX             XXX             XXX             XXX             XXX             XXX                 XXX              XXX             XXX             XXX             XXX             XXX             XXX
//// ├───────────────┼───────────────┼───────────────┼───────────────┼───────────────┼───────────────┼───────────────┤   ├────────────────┼───────────────┼───────────────┼───────────────┼───────────────┼───────────────┼───────────────┤
//     XXX             XXX             XXX             XXX             XXX             XXX             XXX             ,   XXX              XXX             XXX             XXX             XXX             XXX             XXX
//// ├───────────────┼───────────────┼───────────────┼───────────────┼───────────────┼───────────────┼───────────────╯   ╰────────────────┼───────────────┼───────────────┼───────────────┼───────────────┼───────────────┼───────────────┤
//     XXX             XXX             XXX             XXX             XXX             XXX                             ,                    XXX             XXX             XXX             XXX             XXX             XXX
//// ├───────────────┼───────────────┼───────────────┼───────────────┼───────────────┼───────────────╯                                    ╰───────────────┼───────────────┼───────────────┼───────────────┼───────────────┼───────────────┤
//     XXX             XXX             XXX             XXX             XXX                                             ,                                    XXX             XXX             XXX             XXX             XXX
///* ╰───────────────┴───────────────┴───────────────┴───────────────┴───────────────╯                              */ , /*                               ╰───────────────┴───────────────┴───────────────┴───────────────┴───────────────╯ */
////                                                                             ╭────────────────┬───────────────╮         ╭───────────────┬───────────────╮
//                                                                                 XXX                XXX                     XXX             XXX
///*                                                             ╭───────────────┼────────────────┼───────────────┤ */ , /* ├───────────────┼───────────────┼────────────────╮ */
//                                                                                                    XXX                     XXX
///*                                                             |               |                ├───────────────┤ */ , /* ├───────────────|               |                | */
//                                                                 XXX             XXX                XXX                     XXX             XXX             XXX
////                                                             ╰───────────────┴────────────────┴───────────────╯         ╰───────────────┴───────────────┴────────────────╯
//)
